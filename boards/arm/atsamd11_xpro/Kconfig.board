## boards/arm/atsamd11_xpro/Kconfig.board
```kconfig
# SAM D11 Xplained Pro Board configuration

# Copyright (c) 2020 Gavin Hurlbut
# SPDX-License-Identifier: Apache-2.0

config BOARD_ATSAMD11_XPRO
	bool "SAM D11 Xplained Pro"
	depends on SOC_PART_NUMBER_SAMD11D14AM
```

## boards/arm/atsamd11_xpro/Kconfig.defconfig
```kconfig
# SAM D11 Xplained Pro board configuration

# Copyright (c) 2020 Gavin Hurlbut
# SPDX-License-Identifier: Apache-2.0

config BOARD
	default "atsamd11_xpro"
	depends on BOARD_ATSAMD11_XPRO
```

## boards/arm/atsamd11_xpro/atsamd11_xpro_defconfig
```kconfig
# Copyright (c) 2020 Gavin Hurlbut
# SPDX-License-Identifier: Apache-2.0
CONFIG_SOC_SERIES_SAMD11=y
CONFIG_SOC_PART_NUMBER_SAMD11D14AM=y
CONFIG_BOARD_ATSAMD11_XPRO=y
CONFIG_BUILD_OUTPUT_HEX=y
CONFIG_CORTEX_M_SYSTICK=y
CONFIG_CONSOLE=y
CONFIG_UART_CONSOLE=y
CONFIG_SERIAL=y
CONFIG_UART_SAM0=y
CONFIG_UART_INTERRUPT_DRIVEN=y
CONFIG_GPIO=y
CONFIG_GPIO_SAM0=y
CONFIG_WATCHDOG=y
CONFIG_WDT_SAM0=y
CONFIG_SOC_ATMEL_SAMD1X_OSC8M_AS_MAIN=y
CONFIG_SPI=y
CONFIG_SPI_SAM0=y
CONFIG_PINMUX=y
CONFIG_PINMUX_SAM0=y
```

## boards/arm/beirdo_battery_joule_thief_v1/Kconfig.board
```kconfig
# Beirdo's Battery Joule Thief v1 Config
# Copyright (c) 2020 Gavin Hurlbut
# SPDX-License-Identifier: Apache-2.0

config BOARD_BEIRDO_BATTERY_JOULE_THIEF_V1
	bool "Beirdo's Battery Joule Thief v1"
	depends on SOC_PART_NUMBER_SAMD21E17A
```

## boards/arm/beirdo_battery_joule_thief_v1/Kconfig.defconfig
```kconfig
# Beirdo's Battery Joule Thief v1 board config

# Copyright (c) 2020 Gavin Hurlbut
# SPDX-License-Identifier: Apache-2.0

config BOARD
	default "battery_joule_thief_v1"
	depends on BOARD_BEIRDO_BATTERY_JOULE_THIEF_V1
```

## boards/arm/beirdo_battery_joule_thief_v1/beirdo_battery_joule_thief_v1_defconfig
```kconfig
# Copyright (c) 2020 Gavin Hurlbut
# SPDX-License-Identifier: Apache-2.0

CONFIG_SOC_SERIES_SAMD21=y
CONFIG_SOC_PART_NUMBER_SAMD21E17A=y
CONFIG_SOC_ATMEL_SAMD2X_OSC8M_AS_MAIN=y
CONFIG_BOARD_BEIRDO_BATTERY_JOULE_THIEF_V1=y
CONFIG_BUILD_OUTPUT_HEX=y
CONFIG_BUILD_OUTPUT_STRIPPED=y
CONFIG_CORTEX_M_SYSTICK=y
CONFIG_USE_SEGGER_RTT=n

CONFIG_MAIN_STACK_SIZE=512
CONFIG_IDLE_STACK_SIZE=512
CONFIG_ISR_STACK_SIZE=512

CONFIG_SERIAL=y
CONFIG_UART_INTERRUPT_DRIVEN=y
CONFIG_UART_SAM0=y

CONFIG_CONSOLE=y
CONFIG_UART_CONSOLE=y

CONFIG_GPIO=y
CONFIG_GPIO_SAM0=y
CONFIG_GPIO_MCP23017=y
CONFIG_GPIO_MCP23017_INTERRUPT=y
CONFIG_GPIO_PCF8574=y
CONFIG_GPIO_PCF8574_INTERRUPT=y

CONFIG_WATCHDOG=y
CONFIG_WDT_SAM0=y

CONFIG_DMA=y
CONFIG_DMA_SAM0=y

CONFIG_I2C=y
CONFIG_I2C_SAM0=y
CONFIG_I2C_SAM0_DMA_DRIVEN=y

CONFIG_PINMUX=y
CONFIG_PINMUX_SAM0=y

CONFIG_ADC=y
CONFIG_ADC_MCP342X=y
CONFIG_ADC_SAM0=n

CONFIG_DISPLAY=y
CONFIG_SSD1306=y

CONFIG_PWM=y
CONFIG_PWM_PCA9685=y
CONFIG_PWM_SAM0_TCC=n

CONFIG_HWINFO=y
CONFIG_HWINFO_SAM0=y
```

## drivers/adc/Kconfig.mcp342x
```kconfig
# MCP320x ADC configuration options

# Copyright (c) 2020 Gavin Hurlbut
# SPDX-License-Identifier: Apache-2.0

config ADC_MCP342X
	bool "MCP3425/3426/3427/3428 driver"
	depends on I2C
	select ADC_ASYNC
	help
	  Enable MCP342x ADC driver.

	  The MCP342x a family of 12/14/16-bit Delta-Sigma A/D converters
	  with 1/2/4 inputs and I2C interface.

if ADC_MCP342X

config ADC_MCP342X_INIT_PRIORITY
	int "Init priority"
	default 80
	help
	  MCP342x ADC device driver initialization priority.

endif # ADC_MCP342X
```

## drivers/eeprom/Kconfig.zdu0110xxx
```kconfig
# ZDU0110xxx EEPROM configuration options

# Copyright (c) 2020 Gavin Hurlbut
# SPDX-License-Identifier: Apache-2.0

menuconfig EEPROM_ZDU0110XXX
	bool "ZDU0110xxx EEPROM driver"
	depends on EEPROM
	depends on UART_ZDU0110XXX_EEPROM
	help
	  Enable EEPROM driver for ZDU0110xxx.

	  The ZDU0110xxx is a family of I2C connected UARTs.

	  The ZDU0110xxx UART integrates in a 512 byte EEPROM,
	  implemented as 16 pages of 32 bytes.

config EEPROM_ZDU0110_INIT_PRIORITY
	int "Driver init priority"
	default 99
	depends on EEPROM_ZDU0110XXX
	help
	  Device driver initialization priority. This driver must be
	  initialized after the ZDU0110XXX UART driver.
```

## drivers/gpio/Kconfig.mcp23017
```kconfig
# MCP23017 GPIO configuration options

# Copyright (c) 2016 Intel Corporation
# Copyright (c) 2020 Gavin Hurlbut
# SPDX-License-Identifier: Apache-2.0

menuconfig GPIO_MCP23017
	bool "MCP23017 I2C-based GPIO chip"
	depends on I2C
	help
	  Enable driver for MCP23017 I2C-based GPIO chip.

config GPIO_MCP23017_INIT_PRIORITY
	int "Init priority"
	default 70
	depends on GPIO_PCA95XX
	help
	  Device driver initialization priority.

config GPIO_MCP23017_INTERRUPT
	bool "Interrupt enable"
	default n
	depends on GPIO_PCA95XX
	help
	  Enable interrupt support in MCP23017 driver.
	  Note that the MCP23017 driver has the two interrupts
	  mirrored (wired-AND, active-low) internally so both will
	  trigger on IO changes for either port.
```

## drivers/gpio/Kconfig.pcf8574
```kconfig
# PCA95XX GPIO configuration options

# Copyright (c) 2020 Gavin Hurlbut
# SPDX-License-Identifier: Apache-2.0

menuconfig GPIO_PCF8574
	bool "PCF8574 I2C-based GPIO chip"
	depends on I2C
	help
	  Enable driver for PCF8574 I2C-based GPIO chip.

config GPIO_PCF8574_INIT_PRIORITY
	int "Init priority"
	default 70
	depends on GPIO_PCF8574
	help
	  Device driver initialization priority.

config GPIO_PCF8574_INTERRUPT
	bool "Interrupt enable"
	default n
	depends on GPIO_PCF8574
	help
	  Enable interrupt support in PCF8574 driver.
	  Note that the PCF8574 cannot reliably detect
	  short-pulse interrupts due to its design.
```

## drivers/gpio/Kconfig.zdu0110xxx
```kconfig
# ZDU0110xxx GPIO configuration options

# Copyright (c) 2020 Gavin Hurlbut
# SPDX-License-Identifier: Apache-2.0

menuconfig GPIO_ZDU0110XXX
	bool "ZDU0110xxx GPIO driver"
	depends on GPIO
	depends on UART_ZDU0110XXX_GPIO
	help
	  Enable GPIO driver for ZDU0110xxx.

	  The ZDU0110xxx is a family of I2C connected UARTs.

	  The GPIO port of the ZDU0110xxx (varying sizes depending
	  variant) is exposed as a GPIO controller driver with 
	  read/write support.  Interrupts are supported only on
	  GPIO0 and GPIO1.

config  GPIO_ZDU0110XXX_INTERRUPT
	bool "ZDU0110xxx GPIO Interrupt support"
	depends on GPIO_ZDU0110XXX
	help
	  Enable the use of the GPIO interrupt.  Interrupts are 
	  generated on changes on only GPIO0 and GPIO1.

config GPIO_ZDU0110XXX_INIT_PRIORITY
	int "Driver init priority"
	default 99
	depends on GPIO_ZDU0110XXX
	help
	  Device driver initialization priority. This driver must be
	  initialized after the ZDU0110XXX UART driver.
```

## drivers/pwm/Kconfig.pca9685
```kconfig
# PCA9685 PWM configuration options
#
#
# Copyright (c) 2016 Intel Corporation
#
# SPDX-License-Identifier: Apache-2.0
#

################################################
# PCA9685
################################################

menuconfig PWM_PCA9685
	bool "PCA9685 I2C-based PWM chip"
	depends on I2C
	help
	  Enable driver for PCA9685 I2C-based PWM chip.

if PWM_PCA9685

config PWM_PCA9685_INIT_PRIORITY
	int "Init priority"
	default 70
	help
	  Device driver initialization priority.

endif # PWM_PCA9685
```

## drivers/ram/Kconfig
```kconfig
# off-SOC RAM driver configuration options

# Copyright (c) 2020 Gavin Hurlbut
# SPDX-License-Identifier: Apache-2.0

menuconfig RAM
	bool "Off-SOC RAM hardware support"
	help
	  Enable support for Off-SOC RAM hardware.

if RAM

module = RAM
module-str = ram
source "subsys/logging/Kconfig.template.log_config"

config RAM_SHELL
	bool "Enable RAM shell"
	default y
	depends on SHELL
	help
	  Enable the RAM shell with RAM related commands.

config RAM_SHELL_BUFFER_SIZE
	int "RAM shell buffer size"
	default 256
	depends on RAM_SHELL
	help
	  Size of the buffer used for RAM read/write commands in
	  the RAM shell.

source "drivers/eeprom/Kconfig.mcp23x"

config RAM_SIMULATOR
	bool "Simulated RAM driver"
	select STATS
	select STATS_NAMES
	help
	  Enable Simulated RAM driver.

config RAM_SIMULATOR_SIMULATE_TIMING
	bool "Enable hardware timing simulation"
	depends on EEPROM_SIMULATOR
	help
	  Enable Simulated hardware timing.

if RAM_SIMULATOR_SIMULATE_TIMING

config RAM_SIMULATOR_MIN_READ_TIME_US
	int
	prompt "Minimum read time (µS)"
	default 2
	range 1 1000000

config RAM_SIMULATOR_MIN_WRITE_TIME_US
	int
	prompt "Minimum write time (µS)"
	default 100
	range 1 1000000

endif # RAM_SIMULATOR_SIMULATE_TIMING

endif # RAM
```

## drivers/ram/Kconfig.mcp23x
```kconfig
# Copyright (c) 2020 Gavin Hurlbut
# SPDX-License-Identifier: Apache-2.0

config RAM_MCP23X
	bool
	help
	  Enable support for Microchip 23Axxx.23Kxxx (and compatible) SPI SRAMs.

config RAM_MCP23X_INIT_PRIORITY
	int "23xxxx RAM init priority"
	default 75
	depends on RAM_MCP23X
```

## drivers/serial/Kconfig.zdu0110xxx
```kconfig
# SPDX-License-Identifier: Apache-2.0

config UART_ZDU0110XXX
	depends on I2C
	bool "ZDU0110XXX UART driver"
	select SERIAL_HAS_DRIVER
	select SERIAL_SUPPORT_INTERRUPT
	select SERIAL_HAS_LINE_CTRL
	help
	  This option enables the ZDU0110xxx UART over I2C driver.
	  
if UART_ZDU0110XXX

choice
    prompt "Flow Control type"
	default UART_ZDU0110XXX_FLOW_CONTROL_NONE
    
    config UART_ZDU0110XXX_FLOW_CONTROL_SOFTWARE
        bool "Software (XON/XOFF)"
        
    config UART_ZDU0110XXX_FLOW_CONTROL_HARDWARE
        bool "Hardware (CTS/RTS)"
        
    config UART_ZDU0110XXX_FLOW_CONTROL_NONE
		bool "None"
		
endchoice

config UART_ZDU0110XXX_INIT_PRIORITY
	int "Init priority"
	default 80
	help
	  ZDU0110xxx UART device driver initialization priority.

config UART_ZDU0110XXX_GPIO
	bool "Enable ZDU0110xxx GPIO support"
	depends on GPIO
	select GPIO_ZDU0110XXX
	help
	  Enable GPIO child device support in the ZDU0110xxx UART driver.

	  The GPIO functionality is handled by the ZDU0110xxx GPIO
	  driver.

config UART_ZDU0110XXX_EEPROM
	bool "Enable ZDU0110xxx EEPROM support"
	depends on EEPROM
	select EEPROM_ZDU0110XXX
	help
	  Enable EEPROM child device support in the ZDU0110xxx UART driver.

	  The EEPROM functionality is handled by the ZDU0110xxx EEPROM
	  driver.

endif # UART_ZDU0110XXX
```

## dts/bindings/adc/microchip,mcp3425.yaml
```yaml
description: Microchip MCP3425

compatible: "microchip,mcp3425"

include: microchip,mcp342x-base.yaml
```

## dts/bindings/adc/microchip,mcp3426.yaml
```yaml
description: Microchip MCP3426

compatible: "microchip,mcp3426"

include: microchip,mcp342x-base.yaml
```

## dts/bindings/adc/microchip,mcp3427.yaml
```yaml
description: Microchip MCP3427

compatible: "microchip,mcp3427"

include: microchip,mcp342x-base.yaml
```

## dts/bindings/adc/microchip,mcp3428.yaml
```yaml
description: Microchip MCP3428

compatible: "microchip,mcp3428"

include: microchip,mcp342x-base.yaml
```

## dts/bindings/adc/microchip,mcp342x-base.yaml
```yaml
# Common fields for Microchip MCP3425/3426/3427/3438

include: [adc-controller.yaml, i2c-device.yaml]

properties:
    "#io-channel-cells":
      const: 1

io-channel-cells:
    - channel
```

## dts/bindings/gpio/microchip,mcp23017.yaml
```yaml
#
# Copyright (c) 2020 Gavin Hurlbut
#
# SPDX-License-Identifier: Apache-2.0
#

description: >
    This is a representation of the Microchip MCP23017 I2C GPIO Expander.

compatible: "microchip,mcp23017"

include: [gpio-controller.yaml, i2c-device.yaml]

properties:
    label:
      required: true

    "#gpio-cells":
      const: 2

    interrupt-gpios:
      type: phandle-array
      required: false
      description: Interrupt GPIO pin (active-low open-drain)

    ngpios:
      type: int
      required: true
      const: 16
      description: Number of gpios supported

gpio-cells:
  - pin
  - flags
```

## dts/bindings/gpio/ti,pcf8574.yaml
```yaml
# Copyright (c) 2020 Gavin Hurlbut
# SPDX-License-Identifier: Apache-2.0

description: PCF8574 series I2C-based GPIO expander

compatible: "ti,pcf8574"

include: [gpio-controller.yaml, i2c-device.yaml]

properties:
    label:
      required: true

    interrupt-gpios:
      type: phandle-array
      required: false
      description: Interrupt GPIO pin (active-low open-drain)

    "#gpio-cells":
      const: 2

    ngpios:
      type: int
      required: true
      const: 8
      description: Number of gpios supported

gpio-cells:
  - pin
  - flags
```

## dts/bindings/gpio/zilog,zdu0110qux-gpio.yaml
```yaml
# Copyright (c) 2020 Gavin Hurlbut
# SPDX-License-Identifier: Apache-2.0

description: Zilog ZDU0110QUX GPIO

compatible: "zilog,zdu0110qux_gpio"

include: zilog,zdu0110xxx-gpio-base.yaml

properties:
    ngpios:
      type: int
      const: 12
      description: Number of gpios supported
```

## dts/bindings/gpio/zilog,zdu0110rfx-gpio.yaml
```yaml
# Copyright (c) 2020 Gavin Hurlbut
# SPDX-License-Identifier: Apache-2.0

description: Zilog ZDU0110RFX GPIO

compatible: "zilog,zdu0110rfx_gpio"

include: zilog,zdu0110xxx-gpio-base.yaml

properties:
    ngpios:
      type: int
      const: 3
```

## dts/bindings/gpio/zilog,zdu0110rhx-gpio.yaml
```yaml
# Copyright (c) 2020 Gavin Hurlbut
# SPDX-License-Identifier: Apache-2.0

description: Zilog ZDU0110RHX GPIO

compatible: "zilog,zdu0110rhx_gpio"

include: zilog,zdu0110xxx-gpio-base.yaml

properties:
    ngpios:
      type: int
      const: 7
      description: Number of gpios supported
```
