## dts/bindings/gpio/zilog,zdu0110rjx-gpio.yaml
```yaml
# Copyright (c) 2020 Gavin Hurlbut
# SPDX-License-Identifier: Apache-2.0

description: Zilog ZDU0110RJX GPIO

compatible: "zilog,zdu0110rjx-gpio"

include: zilog,zdu0110xxx-gpio_base.yaml

properties:
    ngpios:
      type: int
      const: 8
      description: Number of gpios supported
```

## dts/bindings/gpio/zilog,zdu0110xxx-gpio-base.yaml
```yaml
# Copyright (c) 2020 Gavin Hurlbut
# SPDX-License-Identifier: Apache-2.0

description: GPIO portion of ZDU0110xxx I2C-based UART

include: gpio-controller.yaml

properties:
  label:
    type: string
    required: true

  interrupt-gpios:
    type: phandle-array
    required: false
    description: Interrupt GPIO pin (active-low open-drain)

  "#gpio-cells":
    const: 2

  ngpios:
    type: int
    required: true
    description: Number of gpios supported

gpio-cells:
  - pin
  - flags
```

## dts/bindings/pwm/nxp,pca9685.yaml
```yaml
# Copyright (c) 2020 Gavin Hurlbut
# SPDX-License-Identifier: Apache-2.0

description: NXP PCA9685 I2C PWM device

compatible: "nxp,pca9685"

include: [i2c-device.yaml, pwm-controller.yaml]

properties:
    "#pwm-cells":
      const: 2
      
    prescaler:
      type: int
      required: true
      description: Prescaler register value

pwm-cells:
  - channel
  - flags
```

## dts/bindings/serial/zilog,zdu0110qux-uart-base.yaml
```yaml
# Copyright (c) 2020 Gavin Hurlbut
# SPDX-License-Identifier: Apache-2.0

description: Zilog ZDU0110QUX Base Device

compatible: "zilog,zdu0110qux"

include: zilog,zdu0110xxx-uart-base.yaml
```

## dts/bindings/serial/zilog,zdu0110rfx-uart-base.yaml
```yaml
# Copyright (c) 2020 Gavin Hurlbut
# SPDX-License-Identifier: Apache-2.0

description: Zilog ZDU0110RFX Base Device

compatible: "zilog,zdu0110rfx"

include: zilog,zdu0110xxx-uart-base.yaml
```

## dts/bindings/serial/zilog,zdu0110rhx-uart-base.yaml
```yaml
# Copyright (c) 2020 Gavin Hurlbut
# SPDX-License-Identifier: Apache-2.0

description: Zilog ZDU0110RHX Base Device

compatible: "zilog,zdu0110rhx"

include: zilog,zdu0110xxx-uart-base.yaml
```

## dts/bindings/serial/zilog,zdu0110rhx-uart-port.yaml
```yaml
# Copyright (c) 2020 Gavin Hurlbut
# SPDX-License-Identifier: Apache-2.0

description: Zilog ZDU0110RHX UART Port

compatible: "zilog,zdu0110rhx_port"

include: zilog,zdu0110xxx-port-base.yaml
```

## dts/bindings/serial/zilog,zdu0110rjx-uart-base.yaml
```yaml
# Copyright (c) 2020 Gavin Hurlbut
# SPDX-License-Identifier: Apache-2.0

description: Zilog ZDU0110RJX Base Device

compatible: "zilog,zdu0110rjx"

include: zilog,zdu0110xxx-base.yaml
```

## dts/bindings/serial/zilog,zdu0110rjx-uart-port.yaml
```yaml
# Copyright (c) 2020 Gavin Hurlbut
# SPDX-License-Identifier: Apache-2.0

description: Zilog ZDU0110RJX UART Port

compatible: "zilog,zdu0110rjx_port"

include: zilog,zdu0110xxx-port-base.yaml
```

## dts/bindings/serial/zilog,zdu0110xxx-port-base.yaml
```yaml
# Copyright (c) 2020 Gavin Hurlbut
# SPDX-License-Identifier: Apache-2.0

description: UART Port portion of ZDU0110xxx I2C-based UART

include: uart-controller.yaml

properties:
    label:
      required: true

    port-number:
      type: int
      required: true
      description: UART port number
```

## dts/bindings/serial/zilog,zdu0110xxx-uart-base.yaml
```yaml
# Copyright (c) 2020 Gavin Hurlbut
# SPDX-License-Identifier: Apache-2.0

description: Base portion of ZDU0110xxx I2C-based UART

include: [uart-controller.yaml, base.yaml]

properties:
    label:
      required: true

    interrupt-gpios:
      type: phandle-array
      required: false
      description: Interrupt GPIO pin (active-low open-drain)
```

## dts/bindings/sram/microchip,23x256.yaml
```yaml
# Copyright (c) 2020 Gavin Hurlbut
# SPDX-License-Identifier: Apache-2.0

description: Microchip 23A256/23K256 (or compatible) SPI SRAM

include: sram-spi.yaml

compatible: microchip,23x256

properties:
    size:
        const: 32768
```

## dts/bindings/sram/microchip,23x640.yaml
```yaml
# Copyright (c) 2020 Gavin Hurlbut
# SPDX-License-Identifier: Apache-2.0

description: Microchip 23A640/23K640 (or compatible) SPI SRAM

include: sram-spi.yaml

compatible: microchip,23x640

properties:
    size:
        const: 8192
```

## dts/bindings/sram/sram-spi.yaml
```yaml
# Copyright (c) 2020 Gavin Hurlbut
# SPDX-License-Identifier: Apache-2.0

# Common fields for SPI EEPROM devices

include: spi-base.yaml

properties:
    address-width:
      type: int
      required: true
      description: SRAM address width in bits
    wp-gpios:
      type: phandle-array
      required: false
      description: |
        GPIO to which the write-protect pin of the chip is connected.

        The device will interpret this signal as active-low.
    size:
      type: int
      required: true
      description: Total SRAM size in bytes
    read-only:
      type: boolean
      required: false
      description: Disable writes to the SRAM
    label:
      required: true
```

## dts/bindings/sram/zephyr,sim-ram.yaml
```yaml
# Copyright (c) 2020 Gavin Hurlbut
# SPDX-License-Identifier: Apache-2.0

description: Zephyr Simulated Off-SOC RAM device

compatible: "zephyr,sim-ram"

include: base.yaml

properties:
    size:
      type: int
      required: false
      description: Total EEPROM size in bytes
    read-only:
      type: boolean
      required: false
      description: Disable writes to the EEPROM
    label:
      required: true
```

## soc/arm/atmel_sam0/samd11/Kconfig.defconfig.series
```kconfig
# Atmel SAMD11 MCU series configuration options

# Copyright (c) 2020 Gavin Hurlbut
# SPDX-License-Identifier: Apache-2.0

if SOC_SERIES_SAMD11

config SOC_SERIES
	default "samd11"

config SOC_PART_NUMBER
	default "samd11c14a" if SOC_PART_NUMBER_SAMD11C14A
	default "samd11d14am" if SOC_PART_NUMBER_SAMD11D14AM
	default "samd11d14as" if SOC_PART_NUMBER_SAMD11D14AS
	default "samd11d14au" if SOC_PART_NUMBER_SAMD11D14AU

config NUM_IRQS
	default 28

config SYS_CLOCK_HW_CYCLES_PER_SEC
	default 48000000

endif # SOC_SERIES_SAMD11
```

## soc/arm/atmel_sam0/samd11/Kconfig.series
```kconfig
# Atmel SAMD11 MCU series

# Copyright (c) 2020 Gavin Hurlbut
# SPDX-License-Identifier: Apache-2.0

config SOC_SERIES_SAMD11
	bool "Atmel SAMD11 MCU"
	select ARM
	select CPU_CORTEX_M0PLUS
	select SOC_FAMILY_SAM0
	select CPU_CORTEX_M_HAS_SYSTICK
	select CPU_CORTEX_M_HAS_VTOR
	select ASF
	help
	  Enable support for Atmel SAMD11 Cortex-M0+ microcontrollers.
```

## soc/arm/atmel_sam0/samd11/Kconfig.soc
```kconfig
# Atmel SAMD11 MCU series

# Copyright (c) 2020 Gavin Hurlbut
# SPDX-License-Identifier: Apache-2.0

choice
	prompt "Atmel SAMD11 MCU Selection"
	depends on SOC_SERIES_SAMD11

config SOC_PART_NUMBER_SAMD11C14A
	bool "SAMD11C14A"

config SOC_PART_NUMBER_SAMD11D14AM
	bool "SAMD11D14AM"

config SOC_PART_NUMBER_SAMD11D14AS
	bool "SAMD11D14AS"

config SOC_PART_NUMBER_SAMD11D14AU
	bool "SAMD11D14AU"

endchoice
```
